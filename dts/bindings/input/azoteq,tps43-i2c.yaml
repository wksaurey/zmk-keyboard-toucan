## dts/bindings/input/azoteq,tps43-i2c.yaml
```yaml
description: |
  Azoteq TPS43 touchpad sensor driver over I2C interface

compatible: "azoteq,tps43"

include: ["i2c-device.yaml", "azoteq,tps43-common.yaml"]
```
